## firmware/main/Kconfig.projbuild
```kconfig
menu "S01 Monitor"

    choice S01_BOARD
        prompt "Hardware the image is built for"
        default S01_BOARD_CAN_BASE
        help
            Which CAN adapter the M5 ATOM Lite is wired to. This only sets the
            two CAN pins. The two adapters cannot be told apart by the
            firmware, so flash the image that matches the hardware.

        config S01_BOARD_CAN_BASE
            bool "M5 ATOM Lite + Atomic CAN Base (CAN on the base: TX 22, RX 19)"

        config S01_BOARD_GROVE_CAN
            bool "M5 ATOM Lite + Unit CAN on the Grove port (TX 26, RX 32) + Atomic TF Card Base (assumed fitted)"

    endchoice

    config S01_CAN_TX_GPIO
        int
        default 22 if S01_BOARD_CAN_BASE
        default 26 if S01_BOARD_GROVE_CAN

    config S01_CAN_RX_GPIO
        int
        default 19 if S01_BOARD_CAN_BASE
        default 32 if S01_BOARD_GROVE_CAN

    config S01_HAS_SD
        bool "An SD card (Atomic TF Card Base) is fitted"
        default y if S01_BOARD_GROVE_CAN
        default n
        help
            Adds the SD card screen's web endpoints and the recorder. The base
            ties the card's chip select to ground, so there is no CS pin.

    config S01_SD_MOSI_GPIO
        int
        default 19
        depends on S01_HAS_SD

    config S01_SD_MISO_GPIO
        int
        default 33
        depends on S01_HAS_SD

    config S01_SD_CLK_GPIO
        int
        default 23
        depends on S01_HAS_SD

endmenu
```
